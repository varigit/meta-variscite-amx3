## conf/layer.conf
```bitbake
# We have a conf and classes directory, add to BBPATH
BBPATH .= ":${LAYERDIR}"

# We have recipes-* directories, add to BBFILES
BBFILES += "${LAYERDIR}/recipes-*/*/*.bb \
            ${LAYERDIR}/recipes-*/*/*.bbappend \
           "

BBFILE_COLLECTIONS += "var-som-amx3"
BBFILE_PATTERN_var-som-amx3 = "^${LAYERDIR}/"
BBFILE_PRIORITY_var-som-amx3 = "16"
```

## conf/machine/include/var-ti33x.inc
```bitbake
SOC_FAMILY = "ti33x"
require conf/machine/include/soc-family.inc

DEFAULTTUNE ?= "cortexa8thf-neon"
require conf/machine/include/tune-cortexa8.inc

PREFERRED_PROVIDER_virtual/xserver = "xserver-xorg"

# For built-in LCD, add xf86-input-tslib
XSERVER = "xserver-xorg \
           xf86-input-evdev \
           xf86-input-mouse \
           xf86-video-fbdev \
           xf86-input-keyboard"

# Default to external video, change to smallscreen for built-in LCD
MACHINE_GUI_CLASS = "bigscreen"

# Increase this everytime you change something in the kernel
MACHINE_KERNEL_PR = "r22"

# Default providers, may need to override for specific machines
PREFERRED_PROVIDER_virtual/kernel = "linux-ti-variscite"
PREFERRED_PROVIDER_virtual/kernel_varsomam33 = "linux-ti-variscite"
PREFERRED_PROVIDER_virtual/bootloader = "u-boot-var-som-am33"
PREFERRED_PROVIDER_virtual/bootloader_varsomam33 = "u-boot-var-som-am33"
PREFERRED_PROVIDER_u-boot = "u-boot-var-som-am33"
PREFERRED_PROVIDER_u-boot_varsomam33 = "u-boot-var-som-am33"

KERNEL_IMAGETYPE = "zImage"

UBOOT_ARCH = "arm"
UBOOT_MACHINE = "var-som-am33"

UBOOT_ENTRYPOINT = "0x80008000"
UBOOT_LOADADDRESS = "0x80008000"

# Use the expected value of the ubifs filesystem's volume name in the kernel
# and u-boot.
UBI_VOLNAME = "rootfs"

EXTRA_IMAGEDEPENDS += "u-boot"

# List common SoC features, may need to add touchscreen for specific machines
MACHINE_FEATURES = "kernel26 apm usbgadget usbhost vfat ext2 screen alsa ethernet sgx"
```

## conf/machine/include/var-ti43x.inc
```bitbake
SOC_FAMILY = "ti43x"
require conf/machine/include/soc-family.inc

DEFAULTTUNE ?= "cortexa9thf-neon"
require conf/machine/include/tune-cortexa9.inc

PREFERRED_PROVIDER_virtual/xserver = "xserver-xorg"

# For built-in LCD, add xf86-input-tslib
XSERVER = "xserver-xorg \
           xf86-input-evdev \
           xf86-input-mouse \
           xf86-video-fbdev \
           xf86-input-keyboard"

# Default to external video, change to smallscreen for built-in LCD
MACHINE_GUI_CLASS = "bigscreen"

# Increase this everytime you change something in the kernel
MACHINE_KERNEL_PR = "r3"

# Default providers, may need to override for specific machines
PREFERRED_PROVIDER_virtual/kernel = "linux-ti-variscite"
PREFERRED_PROVIDER_virtual/kernel_varsomam43 = "linux-ti-variscite"
PREFERRED_PROVIDER_virtual/bootloader = "u-boot-var-som-am43"
PREFERRED_PROVIDER_virtual/bootloader_varsomam43 = "u-boot-var-som-am43"
PREFERRED_PROVIDER_u-boot = "u-boot-var-som-am43"
PREFERRED_PROVIDER_u-boot_varsomam43 = "u-boot-var-som-am43"

KERNEL_IMAGETYPE = "zImage"

UBOOT_ARCH = "arm"
UBOOT_MACHINE = "varsomam43_config"

UBOOT_ENTRYPOINT = "0x80008000"
UBOOT_LOADADDRESS = "0x80008000"

# Use the expected value of the ubifs filesystem's volume name in the kernel
# and u-boot.
UBI_VOLNAME = "rootfs"

EXTRA_IMAGEDEPENDS += "u-boot"

# List common SoC features, may need to add touchscreen for specific machines
MACHINE_FEATURES = "kernel26 apm usbgadget usbhost vfat ext2 screen alsa ethernet sgx"
```

## conf/machine/varsomam43.conf
```bitbake
#@TYPE: Machine
#@NAME: VAR-SOM-AM43
#@DESCRIPTION: Machine configuration for Variscite VAR-SOM-AM43

require conf/machine/include/var-ti43x.inc

# Use built-in LCD by default
XSERVER += "xf86-input-tslib"
GUI_MACHINE_CLASS = "smallscreen"
MACHINE_FEATURES += "touchscreen"

IMAGE_FSTYPES += "ubi tar.gz"

SERIAL_CONSOLE = "115200 ttyO0"

SYSVINIT_ENABLED_GETTYS = ""

# ignore arago psplash changes
BBMASK = "meta-arago/meta-arago-distro/recipes-core/psplash"

# UBI information.  Note that this is board and kernel specific.  Changes
# in your kernel port may require changes in these variables.  For more
# details about this board please see
# http://processors.wiki.ti.com/index.php/UBIFS_Support

# do ubiattach /dev/ubi_ctrl -m 11 -O 4096
# From dmesg:
# UBI: smallest flash I/O unit:    4096
# UBI: logical eraseblock size:    253952 bytes
# from ubiattach stdout:
# UBI device number 0, total 994 LEBs
MKUBIFS_ARGS = "-F -m 4096 -e 253952 -c 2200"

# do ubiattach /dev/ubi_ctrl -m 11 -O 4096
# from dmesg:
# UBI: smallest flash I/O unit:    4096
# UBI: physical eraseblock size:   262144 bytes (256 KiB)
# UBI: sub-page size:              4096
# UBI: VID header offset:          4096 (aligned 4096)
UBINIZE_ARGS = "-m 4096 -p 256KiB -s 4096 -O 4096"

IMAGE_INSTALL_append = " tslib tslib-calibrate tslib-tests wl12xx-firmware-ti"
```
